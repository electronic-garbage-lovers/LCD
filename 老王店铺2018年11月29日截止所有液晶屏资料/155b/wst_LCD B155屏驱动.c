//晓熊编写 STC12C5A60S2单片机 4M   UV2编译
//老王WST LCD B155屏驱动程序，实际是160*160屏 UC1698

//#include <reg51.h>    //51头文件
#include <STC12C5A60S2.H>  //我用的STC125a60s2,如果用51应该屏蔽
#include <intrins.h>

#define uchar unsigned char
#define uint unsigned int
#define _Nop() _nop_(); _nop_();

#define  dport  P0 //数据口

//引脚定义
sbit cs=P1^0;	      
sbit rs=P1^1;		  
sbit rd=P1^2;		  
sbit wr=P1^3;		 
sbit rst=P1^5;       
//以纵向8个连续点构成一个字节,最上边的点为字节的最低位,即BIT0,最下边的点为BIT7。
//  24×24汉字按每行24字节,共3行取字模,每个汉字共72字节左上角→右上角→左下角→右下角。


unsigned char code hanzi[]={

/*No:0	晓   使用频度=1*/
	0x00,0x00,0xF0,0x20,0x20,0x20,0x20,0xF0,0x00,0x40,0x40,0x40,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0x00,
/*No:1	熊   使用频度=1*/
	0x00,0x00,0x40,0xE0,0xD0,0x58,0x4C,0x44,0x40,0x50,0x60,0xC0,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0x00,
/*No:2	液   使用频度=1*/
	0x00,0x00,0x00,0x00,0x18,0x70,0x20,0x00,0x00,0x20,0x20,0xE0,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0x00,
/*No:3	晶   使用频度=1*/
	0x00,0x00,0x00,0x00,0x00,0x00,0x00,0xFC,0x48,0x48,0x48,0x48,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0x00,
/*No:4	测   使用频度=1*/
	0x00,0x80,0x00,0x04,0x18,0x30,0x00,0xFC,0xF8,0x08,0xC8,0x88,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0x00,
/*No:5	试   使用频度=1*/
	0x00,0x00,0x00,0x08,0x30,0x60,0x00,0x00,0x80,0x80,0x80,0x80,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0x00,
/*No:6	程   使用频度=1*/
	0x00,0x00,0x10,0x10,0x10,0x08,0xF8,0x08,0x0C,0x08,0x00,0x0C,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0x00,
/*No:7	序   使用频度=1*/
	0x00,0x00,0x00,0x00,0xF0,0x10,0x10,0x90,0x90,0x90,0x92,0x94,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0x00,
	};



unsigned char code try[]=
{/*--  文字:  我  --*/
/*--  宋体18;  此字体下对应的点阵为：宽x高=24x24   --*/
0x00,0x00,0x00,0x20,0x10,0x10,0x10,0xF0,0x18,0x08,0x0C,0x00,0x00,0xFC,0x08,0x00,
0x00,0x18,0x70,0x60,0x00,0x00,0x00,0x00,0x00,0x00,0x82,0x82,0x82,0x82,0x42,0xFF,
0x42,0x22,0x22,0x22,0x22,0x3F,0xFF,0x02,0xC2,0x62,0x3E,0x1A,0x01,0x01,0x00,0x00,
0x00,0x00,0x01,0x01,0x20,0x20,0x60,0x3F,0x00,0x20,0x10,0x08,0x08,0x04,0x07,0x07,
0x0D,0x18,0x30,0x20,0x60,0x7C,0x40,0x00,

/*--  文字:  你  --*/
/*--  宋体18;  此字体下对应的点阵为：宽x高=24x24   --*/
0x00,0x00,0x00,0x00,0x00,0xC0,0x78,0x1C,0x04,0x00,0x00,0xE0,0xBC,0x8C,0x80,0x80,
0x80,0x80,0x80,0x80,0xC0,0xC0,0x00,0x00,0x00,0x30,0x08,0x04,0x03,0xFF,0x01,0x00,
0x08,0x06,0xC1,0x70,0x10,0x00,0x00,0xFE,0x00,0x00,0x20,0x63,0xC1,0x00,0x00,0x00,
0x00,0x00,0x00,0x00,0x00,0x7F,0x20,0x00,0x0C,0x03,0x01,0x00,0x20,0x20,0x60,0x3F,
0x00,0x00,0x00,0x00,0x01,0x0F,0x00,0x00,

/*--  文字:  他  --*/
/*--  宋体18;  此字体下对应的点阵为：宽x高=24x24   --*/
0x00,0x00,0x00,0x00,0x80,0xE0,0x3E,0x0C,0x04,0x00,0xC0,0x00,0x00,0x00,0xFC,0x04,
0x00,0x00,0x00,0x80,0x80,0x00,0x00,0x00,0x00,0x20,0x10,0x0C,0x03,0xFF,0x00,0x00,
0x04,0x04,0xFF,0x04,0x02,0x02,0xFF,0x01,0x01,0x81,0x81,0xFF,0x00,0x00,0x00,0x00,
0x00,0x00,0x00,0x00,0x00,0x7F,0x00,0x00,0x00,0x00,0x3F,0x60,0x60,0x60,0x67,0x60,
0x60,0x60,0x61,0x60,0x60,0x3E,0x20,0x00,

/*--  文字:  朋  --*/
/*--  宋体18;  此字体下对应的点阵为：宽x高=24x24   --*/
0x00,0x00,0x00,0x00,0xF8,0x08,0x08,0x08,0x08,0xF8,0x08,0x00,0x00,0xF8,0xF8,0x08,
0x08,0x08,0x08,0x08,0xF8,0x00,0x00,0x00,0x00,0x00,0x00,0x00,0xFF,0x21,0x21,0x21,
0x21,0xFF,0x00,0x00,0x00,0xFF,0xFF,0x21,0x21,0x21,0x21,0x21,0xFF,0x00,0x00,0x00,
0x00,0x40,0x30,0x0F,0x01,0x00,0x10,0x10,0x30,0x3F,0x40,0x20,0x18,0x07,0x00,0x00,
0x00,0x20,0x60,0x70,0x3F,0x00,0x00,0x00,

/*--  文字:  友  --*/
/*--  宋体18;  此字体下对应的点阵为：宽x高=24x24   --*/
0x00,0x00,0x40,0x40,0x40,0x40,0x40,0x40,0x40,0xF0,0x7C,0x44,0x40,0x40,0x40,0x40,
0x40,0x40,0x40,0x60,0x60,0x40,0x00,0x00,0x00,0x00,0x00,0x00,0x00,0x00,0x80,0xE0,
0x3C,0x07,0x18,0x68,0x88,0x08,0x08,0xC8,0x78,0x1C,0x00,0x00,0x00,0x00,0x00,0x00,
0x00,0x40,0x20,0x10,0x08,0x06,0x43,0x40,0x40,0x20,0x20,0x10,0x09,0x0E,0x06,0x09,
0x18,0x30,0x30,0x60,0x60,0x20,0x00,0x00,
	
	};
unsigned char code ni[]=
{
	
0x00,0x40,0xB2,0x96,0x9A,0x92,0xF6,0x9A,0x93,0x91,0x99,0x97,0x91,0x90,0x30,0x00,
0x40,0x20,0xA0,0x90,0x4C,0x47,0x2A,0x2A,0x12,0x1A,0x26,0x22,0x40,0xC0,0x40,0x00,

	};



void delay_us(uint us)
{
	while(us--);
}

void delay_ms(uint ms)
{
	uchar i;
	while(ms--)
		for(i=0;i<120;i++);
}

/*uchar read(bit flag)
{
	uchar temp;
	dport=0xff;
	cs=0;
	rs=flag;
	rd=0;
	wr=1;
	temp=P1;		
	rd=1;
	return temp;
}	   */


void write(bit flag,uchar dat)
{
	cs=0;_Nop()
	rs=flag;	_Nop()				//flag=1,write command;flag=0,write data
	wr=0;_Nop()
	rd=1;_Nop()
	dport=dat;_Nop()
	wr=1;_Nop()
}

void init(void)
{
	cs=0;_Nop()

	//reset
	rst=0;delay_ms(20);
	delay_ms(20);			//power on reset
	rst=1;
	delay_ms(200);delay_ms(500);
	write(0,0xe2);			//reset by command
	delay_ms(2);
    delay_ms(20);
	//power control					
	write(0,0xe9);			//Bias Ratio:1/10 bias
	write(0,0x2b);			//power control set as internal power
	write(0,0x25);			//set temperate compensation as 0%
	write(0,0x81);			//electronic potentionmeter
   //	write(0,198);	   //0xc6不起作用
    write(0,138);

	//display control
	write(0,0xa4);//关闭所有像素			//all pixel off 
	//write(0,0xa5);//打开所有像素点 即点亮整个屏幕
	write(0,0xa6);//关闭像素反显 决定屏幕反显			//inverse display off
//	write(0,0xa7); //打开像素反显 决定屏幕反显

	//lcd control
	write(0,0xc0);			//19:partial display and MX disable,MY enable
//	write(0,0xc7);//不管用？？
	
	write(0,0xa3);			//line rate 15.2klps
	write(0,0xd1);			//rgb-rgb
	// write(0,0xd0);//BGR-BGR
	
	write(0,0xd5);			//4k color mode	 12-bit/RGB
   // write(0,0xd6);			//64K color mode 5R-6G-5B 16-bit/RGB
	
	write(0,0x84);			//12:partial display control disable

	//n-line inversion
	write(0,0xc8);
	//write(0,0x10);			//enable NIV

	//com scan fuction
	write(0,0xda);			//enable FRC,PWM,LRM sequence


	//window 显示窗口大小设置
	write(0,0xf4);			//wpc0:column	starting column address	列起始地址
	write(0,0x25);			//start from 130   37
	write(0,0xf6);			//wpc1			 ending column address	 列结束地址
	write(0,0x5A);			//end:272 	   90
	//因为列开始到结尾共90-37=53个数所以 一个数代表160/53=3个像素

	write(0,0xf5);			//wpp0:row		 starting row address	  行起始地址
	write(0,0x00);			//start from 0
	write(0,0xf7);			//wpp1			 ending  row address	   行结束地址
	write(0,0x9F);			//end 160  0x9F=159
	//行开始到结束共160个数所以一个数代表160/160=1个像素

	write(0,0xf8);			//inside mode   set window program mode

	write(0,0x89);			//RAM control   地址自动加一    AC1=0 列先增加	  AC2=0  控制行增加+1还是-1	 AC0=1
    //write(0,0x8b);	   //是0x89的90°翻转显示			AC1=1 行先增加								 AC0=1
    //write(0,0x8d);	   //							    AC1=0             AC2=1  控制行增加+1还是-1	 AC0=1
	//write(0,0x8a);


	write(0,0xad);			//display on,select on/off mode.Green Enhance mode disable	 背景深黑雪花
	//write(0,0xa8);//wrong	
   //	write(0,0xa9);//和0xad一个效果  有雪花	
   //	write(0,0xac);	//wrong
    //write(0,0xaf);	 //另一种灰度  浅黑雪花


	//scroll line 滚动行
	write(0,0x40);			//low bit of scroll line
	write(0,0x50);			//high bit of scroll line
	write(0,0xc4);			//19,enable FLT and FLB
	write(0,0x90);			//14:FLT,FLB set
	write(0,0x00);

	//partial display 部分显示
	write(0,0x84);			//12,set partial display control:off
	write(0,0xf1);			//com end
	write(0,0x9f);			//160
	write(0,0xf2);			//display start 
	write(0,0);				//0
	write(0,0xf3);			//display end
	write(0,159);			//160	
}


void words_1616(uchar x,uchar y,uchar type,uchar *p)	//type=1,ascii;type=2,Chinese character	  显示16*16像素	汉字
{		 //x控制列显示地址  y控制行显示地址
//汉字取模方式 16*16 纵向取模  	字节倒序
	uchar i,k,j,m,n,l,x0,dat0,dat1,dat2,dat3,dat6;
	x=37+x;	 //控制LCD RAM地址用
	x0=0x00|(x&0x0f);
	x=0x10|((x&0xf0)>>4);
	for(i=0;i<2;i++)  //横向 2个字节 因为是纵向取模 所以横向 共2*8=16个像素点  i的上限为字符宽度/8 eg：16/8=2
	{  //i的值控制着字符宽度若显示48*24则for(i=0;i<6;i++)
		n=i*8*type;  //纵向 type==2时为汉字 因为是16*16尺寸的汉字所以纵向每次需要16个bit
		//n的值控制着字符高度像素若显示24*48则n=i*24*type (type==2时显示汉字)
		for(j=0;j<8;j++)//j的8次循环负责将取模字节中的数据还原成8bit像素数据
		{
			m=i*8+j;  //控制LCD RAM的地址

			write(0,0x89); //地址自动加一

			write(0,x0);// write display address   area
			write(0,x);//  write display address   area
			write(0,0x60|((y+m)&0x0f));	//  write display address   area
			write(0,0x70|(((y+m)&0xf0)>>4)); //	 write display address   area

			for(k=0;k<2*type;k++)//此循环显示汉字的时候执行4*4=16个字节（for循环中用dat0-dat4计算字模中的4个字节）
								
			{					    
				l=k*4+n;//l和n联合控制汉字高度因为是24*24所以每次执行4*4=16个循环  其中(4表示k的数据范围 4表示k的公倍数)

				dat6=0x01<<j;//通过上一层j的for循环来取出没个字节中的8bit数据
				dat0=(*(p+l))&dat6;
				dat0=dat0>>j;
				dat0<<=7;  //取出字模数组中第p+l个字节的第j位并移到第8位上
				
				dat1=(*(p+l+1))&dat6;
				dat1=dat1>>j;
				dat1<<=3;//取出字模数组中第p+l+1个字节的第j位并移到第4位上

				dat2=*(p+2+l)&dat6;
				dat2=dat2>>j;
				dat2<<=7;//取出字模数组中第p+l+2个字节的第j位并移到第8位上

				dat3=(*(p+3+l))&dat6;
				dat3=dat3>>j;
				dat3<<=3;//取出字模数组中第p+l+3个字节的第j位并移到第8位上

				write(1,dat0|dat1);	//写入的数据是16进制包含2个字节数据	将dat0放到高4位 dat1放到第4位
				write(1,dat2|dat3);
			}
			write(0,0x88);	//
		}
	}
	write(0,0x89);
}



void words_2424(uchar x,uchar y,uchar type,uchar *p)	//type=1,ascii;type=2,Chinese character	  显示24*24像素
{		 //x控制列显示地址  y控制行显示地址
//汉字取模方式 24*24 纵向取模  	字节倒序
	uchar i,k,j,m,n,l,x0,dat0,dat1,dat2,dat3,dat4,dat5,dat6;
	x=37+x;
	x0=0x00|(x&0x0f);
	x=0x10|((x&0xf0)>>4);
	for(i=0;i<3;i++)  //横向 3个字节 因为是纵向取模 所以横向 共3*8=24个像素点  i的上限为字符宽度/8 eg：24/8=3
	{  //i的值控制着字符宽度若显示48*24则for(i=0;i<6;i++)
		n=i*12*type;  //纵向 type==2时为汉字 因为是24*24尺寸的汉字所以纵向每次需要24个bit
		//n的值控制着字符高度像素若显示24*48则n=i*24*type (type==2时显示汉字)
		for(j=0;j<8;j++)//j的8次循环负责将取模字节中的数据还原成8bit像素数据
		{
			m=i*8+j;  //控制LCD RAM的地址

			write(0,0x89); //地址自动加一

			write(0,x0);// write display address   area
			write(0,x);//  write display address   area
			write(0,0x60|((y+m)&0x0f));	//  write display address   area
			write(0,0x70|(((y+m)&0xf0)>>4)); //	 write display address   area

			for(k=0;k<2*type;k++)//此循环显示汉字的时候执行4*6=24个字节（for循环中用dat0-dat6计算字模中的6个字节）
								
			{					    
				l=k*6+n;//l和n联合控制汉字高度因为是24*24所以每次执行4*6=24个循环  其中(4表示k的数据范围 6表示k的公倍数)

				dat6=0x01<<j;//通过上一层j的for循环来取出没个字节中的8bit数据
				dat0=(*(p+l))&dat6;
				dat0=dat0>>j;
				dat0<<=7; //取出字模数组中第p+l个字节的第j位并移到第8位上
				
				dat1=(*(p+l+1))&dat6;
				dat1=dat1>>j;
				dat1<<=3;//取出字模数组中第p+l+1个字节的第j位并移到第4位上

				dat2=*(p+2+l)&dat6;
				dat2=dat2>>j;
				dat2<<=7; //取出字模数组中第p+2个字节的第j位并移到第8位上

				dat3=(*(p+3+l))&dat6;
				dat3=dat3>>j;
				dat3<<=3;//取出字模数组中第p+l+3个字节的第j位并移到第4位上

				dat4=(*(p+4+l))&dat6;
				dat4=dat4>>j;
				dat4<<=7; //取出字模数组中第p+l+4个字节的第j位并移到第8位上

				dat5=(*(p+5+l))&dat6;
				dat5=dat5>>j;
				dat5<<=3; //取出字模数组中第p+l+5个字节的第j位并移到第4位上

				write(1,dat0|dat1);	//写入的数据是16进制包含2个字节数据	将dat0放到高4位 dat1放到第4位
				write(1,dat2|dat3);
				write(1,dat4|dat5);

			}
			write(0,0x88);	//
		}
	}
	write(0,0x89);
}	   

void picture(uchar *p)
{
	uchar i,k;
	write(0,0x60);			//row address LSB
	write(0,0x70);			//row address MSB
	write(0,0x05);			//culomn address LSB
	write(0,0x12);			//culomn address MSB

	for(i=0;i<160;i++)

	{
			for(k=0;k<81;k++)
			{											
				write(1,*p++); 
			}
	}
}
void Set_LcdRam_Addr(uchar x,uchar y)
{	   //显示窗口大小设置--满屏
	   write(0,0xf4);  //set window program starting column address  
	   write(0,0x25);
	   write(0,0xf6); //set window program ending column address 
	   write(0,0x5a);
	   write(0,0xf5); //set window program starting row address 
	   write(0,0x00);
	   write(0,0xf7); //set window program ending row address
	   write(0,0x77);

	   write(0,0x70|((x>>4)&0x0f));	  //row MSB
	   write(0,0x60|(x&0x0f));		  //row LSB 
	   write(0,0x10|(((y+0x25)>>4)&0x07)); //column MSB
	   write(0,0x00|((y+0x25)&0x0f));	   //column LSB


	   write(0,0xf8);  //window program mode--inside

}
void lcd_part(uchar x,uchar y,uchar x_len,uchar y_len)//x起始行地址	y：列起始地址  x_len显示的高度
{													  //y_len：显示的长度
	unsigned char  i,j;

	for(i=0;i<x_len;i++)
	{
		Set_LcdRam_Addr(x+i,y);
	//	for(j=0;j<(y_len*3)/2;j++)
		for(j=0;j<(y_len);j++)  //1
		{	
			write(1,0xff);
		}
	}
}

/*void lcd_hanzi(uchar x,uchar y,uchar *p)//x起始行地址	y：列起始地址  x_len显示的高度
{													  //y_len：显示的长度
	unsigned char  i,j;

	for(i=0;i<40;i++)
	{
		Set_LcdRam_Addr(x+i,y);
		for(j=0;j<40;j++)
		write(1,*p++);
	}
} */

void lcdclear(uchar dat1)
{
	uchar i,j;
	write(0,0x60);			//row address LSB    最低有效位
	write(0,0x70);			//row address MSB    最高有效位
	write(0,0x05);			//culomn address LSB 最低有效位
	write(0,0x12);			//culomn address MSB 最高有效位

 	for(j=0;j<160;j++)
	{
		for(i=0;i<27;i++)
		
		{
			
				write(1,dat1);	//见手册中的第21条命令格式  将RGB的每3个字节存到16位寄存器中
				write(1,dat1);
				write(1,dat1);	
		}
	
	}
}


/*void lcdscan(uchar dat1,uchar dat2)
{
	uchar i,j;
	write(0,0x60);			//row address LSB    最低有效位
	write(0,0x70);			//row address MSB    最高有效位
	write(0,0x05);			//culomn address LSB 最低有效位
	write(0,0x12);			//culomn address MSB 最高有效位

 


	for(j=0;j<160;j++)
	{
		for(i=0;i<27;i++)
		{
			
	
				if(j%2==0)
			{
				write(1,dat1);	//见手册中的第21条命令格式  将RGB的每3个字节存到16位寄存器中
				write(1,dat1);	//没条指令包含RGB共12位数据存放格式是占用16位内存所以每个里面执行3条语句相当于3*2=6字节
				write(1,dat1);	//所以执行完里边循环相当于27*6=162满屏
			}//此循环也可以用for(i=0;i<81;i++){write(1,dat1);}替换即只有一条循环语句外面有81个81*1*2=162满屏
			else
			{
				write(1,dat2);
				write(1,dat2);
				write(1,dat2);
			}			
		}
	
	}

} 	  */



  void lcdscan(uchar dat1,uchar dat2)
{
	uchar i,j;
	write(0,0x60);			//row address LSB    最低有效位
	write(0,0x70);			//row address MSB    最高有效位
	write(0,0x05);			//culomn address LSB 最低有效位
	write(0,0x12);			//culomn address MSB 最高有效位

	for(j=0;j<160;j++)
	{
		for(i=0;i<27;i++)
		{
			if(j%2==0)
			{					 
				write(1,dat1);	//见手册中的第21条命令格式  将RGB的每3个字节存到16位寄存器中
				write(1,dat1);	//没条指令包含RGB共12位数据存放格式是占用16位内存所以每个里面执行3条语句相当于3*2=6字节
				write(1,dat1);	//所以执行完里边循环相当于27*6=162满屏
			}//此循环也可以用for(i=0;i<81;i++){write(1,dat1);}替换即只有一条循环语句外面有81个81*1*2=162满屏
			else
			{
				write(1,dat2);
				write(1,dat2);
				write(1,dat2);
			}		
		}

		
		
		
	}
}	  

void display_5character(uchar addry,uchar addrx,uchar type,uchar *p)
//void display_5character(uchar addry,uchar type,uchar *p)
{	  //addrx-lie address,addry-hang address,type-2汉字 type-1 ascii *汉字数组所指向的地址指针  
	uchar i,j,*temp;
	for(i=0;i<6;i++) //�
	{
		temp=p+i*72;
		j=9*i+4;
	//	words_2424(j,addry,type,temp);//j控制列地址  10控制在第10行上显示
	words_2424(addry*i+4,addrx,type,temp);//j控制列地址  10控制在第10行上显示
	}
} 






void main(void)
{	 
//	uchar *p,*e;								 

	//bl=1;  //LCD 背光



	init();	
	lcdclear(0x00);	//清屏
	

	while(1)
	{
	

	    // display_5character(6,10,2,try);
	     display_5character(8,30,2,hanzi);
	    // display_5character(10,70,2,hanzi);
	   //display_5character(10,100,2,hanzi);
	   //display_5character(10,130,2,try);

	
	}
}

